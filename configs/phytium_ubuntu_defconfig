## configs/phytium_ubuntu_defconfig
```kconfig
# Architecture
BR2_aarch64=y
BR2_cortex_a53=y

# Filesystem
BR2_TARGET_ROOTFS_EXT2=y
BR2_TARGET_ROOTFS_EXT2_4=y
BR2_TARGET_ROOTFS_TAR_XZ=y
BR2_TARGET_ROOTFS_EXT2_SIZE="12G"
BR2_ROOTFS_POST_IMAGE_SCRIPT="board/phytium/post-image.sh support/scripts/genimage.sh"
BR2_ROOTFS_POST_SCRIPT_ARGS="-c board/phytium/genimage-5.10.cfg"

# custom skeleton
BR2_ROOTFS_SKELETON_CUSTOM=y
BR2_ROOTFS_SKELETON_UBUNTU=y
BR2_ROOTFS_POST_CUSTOM_SKELETON_SCRIPT="board/phytium/common/post-custom-skeleton-ubuntu.sh"
BR2_ROOTFS_POST_BUILD_SCRIPT="board/phytium/common/post-build.sh"
BR2_INIT_NONE=y
BR2_ROOTFS_MERGED_USR=y
BR2_ENABLE_LOCALE_PURGE=n
BR2_ROOTFS_DEVICE_TABLE="system/device_table.txt board/phytium/common/device_table.txt"

# Hostname and issue
BR2_TARGET_GENERIC_HOSTNAME="Phytium"
BR2_TARGET_GENERIC_ISSUE="Welcome to Phytium"

# toolchain
BR2_TOOLCHAIN_EXTERNAL=y
BR2_TOOLCHAIN_EXTERNAL_ARM_AARCH64=y
BR2_TOOLCHAIN_USES_GLIBC=y
BR2_TOOLCHAIN_EXTERNAL_GLIBC=y

# Linux headers same as kernel
BR2_PACKAGE_HOST_LINUX_HEADERS_CUSTOM_4_19=y

# Kernel
BR2_LINUX_KERNEL=y
BR2_LINUX_KERNEL_CUSTOM_GIT=y
BR2_LINUX_KERNEL_CUSTOM_REPO_URL="https://gitee.com/phytium_embedded/phytium-linux-kernel.git"
# kernel 5.10
BR2_LINUX_KERNEL_CUSTOM_REPO_VERSION="kernel-5.10_v2.2"
BR2_LINUX_KERNEL_INTREE_DTS_NAME="phytium/e2000d-chillipi-edu-board phytium/e2000d-demo-board phytium/e2000d-miniitx-board phytium/e2000d-power-board phytium/e2000q-come-board phytium/e2000q-demo-board phytium/e2000q-edu-board phytium/e2000q-hanwei-board phytium/e2000q-miniitx-board phytium/e2000q-vpx-board phytium/e2000s-demo-board phytium/phytiumpi_firefly"
BR2_LINUX_KERNEL_DTS_SUPPORT=y
BR2_LINUX_KERNEL_DEFCONFIG="phytium"
BR2_LINUX_KERNEL_IMAGE_TARGET_CUSTOM=y
BR2_LINUX_KERNEL_IMAGE_TARGET_NAME="Image"
BR2_LINUX_KERNEL_NEEDS_HOST_OPENSSL=y
BR2_ROOTFS_LINUX_HEADERS=y

# Bootloader
BR2_TARGET_GRUB2=y
BR2_TARGET_GRUB2_ARM64_EFI=y

# Serial port config
BR2_TARGET_GENERIC_GETTY=y
BR2_TARGET_GENERIC_GETTY_PORT="ttyAMA0"

# required tools to create the microSD image
BR2_PACKAGE_HOST_DOSFSTOOLS=y
BR2_PACKAGE_HOST_GENIMAGE=y
BR2_PACKAGE_HOST_MTOOLS=y

BR2_PACKAGE_BUSYBOX=n

# util-linux
BR2_PACKAGE_UTIL_LINUX=y
BR2_PACKAGE_UTIL_LINUX_BINARIES=y
```

## configs/phytiumpi_openeuler_defconfig
```kconfig
# Architecture
BR2_aarch64=y

# Toolchain
BR2_TOOLCHAIN_EXTERNAL=y

# Hostname and issue
BR2_TARGET_GENERIC_HOSTNAME="Phytium"
BR2_TARGET_GENERIC_ISSUE="Welcome to Phytium Buildroot"

# system configuration
BR2_ROOTFS_DEVICE_CREATION_DYNAMIC_EUDEV=y
BR2_SYSTEM_BIN_SH_BASH=y
BR2_TARGET_GENERIC_GETTY=y
BR2_TARGET_GENERIC_GETTY_PORT="ttyAMA0"
BR2_TARGET_GENERIC_GETTY_BAUDRATE_115200=y
BR2_ROOTFS_OVERLAY="board/phytium/common/busybox_init_overlay"

# Filesystem
BR2_TARGET_ROOTFS_EXT2=y
BR2_TARGET_ROOTFS_EXT2_4=y
BR2_TARGET_ROOTFS_TAR_XZ=y
BR2_TARGET_ROOTFS_CPIO=y
BR2_TARGET_ROOTFS_CPIO_GZIP=y
BR2_TARGET_ROOTFS_EXT2_SIZE="5G"
BR2_ROOTFS_POST_IMAGE_SCRIPT="board/phytium/post-image.sh support/scripts/genimage.sh"
BR2_ROOTFS_POST_SCRIPT_ARGS="-c board/phytium/genimage-sd.cfg"


# Bootloader
BR2_TARGET_GRUB2=y
BR2_TARGET_GRUB2_ARM64_EFI=y


# required tools to create the microSD image
BR2_PACKAGE_HOST_DOSFSTOOLS=y
BR2_PACKAGE_HOST_GENIMAGE=y
BR2_PACKAGE_HOST_MTOOLS=y

# Kernel
BR2_LINUX_KERNEL=y
BR2_LINUX_KERNEL_CUSTOM_GIT=y
BR2_LINUX_KERNEL_CUSTOM_REPO_URL="https://gitee.com/openeuler/phytium-kernel.git"
# kernel 5.10
BR2_LINUX_KERNEL_CUSTOM_REPO_VERSION="openEuler-22.03-LTS-Phytium"
BR2_LINUX_KERNEL_USE_CUSTOM_CONFIG=y
BR2_LINUX_KERNEL_CUSTOM_CONFIG_FILE="board/phytium/phytium_defconfig"
BR2_LINUX_KERNEL_IMAGE_TARGET_CUSTOM=y
BR2_LINUX_KERNEL_IMAGE_TARGET_NAME="Image"
BR2_LINUX_KERNEL_DTS_SUPPORT=y
BR2_LINUX_KERNEL_INTREE_DTS_NAME="phytium/e2000d-chillipi-edu-board phytium/e2000d-demo-board phytium/e2000d-miniitx-board phytium/e2000d-power-board phytium/e2000q-come-board phytium/e2000q-demo-board phytium/e2000q-edu-board phytium/e2000q-hanwei-board phytium/e2000q-miniitx-board phytium/e2000q-vpx-board phytium/e2000s-demo-board phytium/phytiumpi_firefly"
BR2_LINUX_KERNEL_NEEDS_HOST_OPENSSL=y
BR2_LINUX_KERNEL_NEEDS_HOST_PAHOLE=y
BR2_LINUX_KERNEL_PATCH="$(LINUX_PKGDIR)/kernel-patches/jailhouse/0001-modify-the-dts-of-e2000-linux-kernel-to-reserve-memo.patch"
BR2_LINUX_KERNEL_IMAGEGZ=y

# Target packages
BR2_PACKAGE_BUSYBOX_SHOW_OTHERS=y
BR2_PACKAGE_GZIP=y
BR2_PACKAGE_GDB=y
BR2_PACKAGE_NETPERF=y
BR2_PACKAGE_RT_TESTS=y
BR2_PACKAGE_STRACE=y
BR2_PACKAGE_GREP=y
BR2_PACKAGE_CIFS_UTILS=y
BR2_PACKAGE_E2FSPROGS=y
BR2_PACKAGE_E2FSPROGS_RESIZE2FS=y
BR2_PACKAGE_MTD=y
BR2_PACKAGE_I2C_TOOLS=y
BR2_PACKAGE_PCIUTILS=y
BR2_PACKAGE_SYSSTAT=y
BR2_PACKAGE_FLICKCURL=y
BR2_PACKAGE_FLICKCURL_UTILS=y
BR2_PACKAGE_LIBCURL_CURL=y
BR2_PACKAGE_LIBCURL_VERBOSE=y
BR2_PACKAGE_COLLECTD=y
BR2_PACKAGE_COLLECTD_CURL=y
BR2_PACKAGE_COLLECTD_CURL_JSON=y
BR2_PACKAGE_COLLECTD_CURL_XML=y
BR2_PACKAGE_DHCPCD=y
BR2_PACKAGE_ETHTOOL=y
BR2_PACKAGE_IPERF=y
BR2_PACKAGE_IPERF3=y
BR2_PACKAGE_IPROUTE2=y
BR2_PACKAGE_OPENSSH=y
BR2_PACKAGE_TCPDUMP=y
BR2_PACKAGE_WGET=y
BR2_PACKAGE_WIRELESS_REGDB=y
BR2_PACKAGE_PROCPS_NG=y
BR2_PACKAGE_NANO=y
BR2_PACKAGE_VIM=y
BR2_PACKAGE_JAILHOUSE=y
BR2_PACKAGE_PHYUBOOT=y
BR2_PACKAGE_PHYUBOOT_RAMSIZE="4GB"
BR2_PACKAGE_PHYTIUM_TOOLS=y

# util-linux
BR2_PACKAGE_UTIL_LINUX=y
BR2_PACKAGE_UTIL_LINUX_BINARIES=y

# core python3 modules
BR2_PACKAGE_PYTHON3=y
BR2_PACKAGE_JAILHOUSE_HELPER_SCRIPTS=y
BR2_PACKAGE_PYTHON3_2TO3=y
BR2_PACKAGE_PYTHON3_BERKELEYDB=y
BR2_PACKAGE_PYTHON3_BZIP2=y
BR2_PACKAGE_PYTHON3_CODECSCJK=y
BR2_PACKAGE_PYTHON3_CURSES=y
BR2_PACKAGE_PYTHON3_DECIMAL=y
BR2_PACKAGE_PYTHON3_OSSAUDIODEV=y
BR2_PACKAGE_PYTHON3_READLINE=y
BR2_PACKAGE_PYTHON3_SSL=y
BR2_PACKAGE_PYTHON3_UNICODEDATA=y
BR2_PACKAGE_PYTHON3_SQLITE=y
BR2_PACKAGE_PYTHON3_PYEXPAT=y
BR2_PACKAGE_PYTHON3_XZ=y
BR2_PACKAGE_PYTHON3_ZLIB=y

# External python modules
BR2_PACKAGE_PYTHON_PIP=y
BR2_PACKAGE_PYTHON_MAKO=y
```

## configs/raspberrypi4_64_openeuler_defconfig
```kconfig
# The following contents are arranged in the order of the main menu given by make menuconfig

# Target options
BR2_aarch64=y
BR2_cortex_a72=y
BR2_ARM_FPU_VFPV4=y

# Build options
BR2_DL_DIR="$(TOPDIR)/dl"
BR2_HOST_DIR="$(BASE_DIR)/host"

# Toolchain
BR2_TOOLCHAIN_EXTERNAL=y

# System configuration
BR2_SYSTEM_DHCP="eth0"
BR2_SYSTEM_DEFAULT_PATH="/bin:/sbin:/usr/bin:/usr/sbin:/usr/local/sbin"
BR2_ROOTFS_POST_BUILD_SCRIPT="board/raspberrypi4-64/post-build.sh"
BR2_ROOTFS_POST_IMAGE_SCRIPT="board/raspberrypi4-64/jailhouse/post-image.sh"
BR2_TARGET_GENERIC_HOSTNAME="Raspberry Pi"
BR2_TARGET_GENERIC_ISSUE="Welcome to Raspberry Pi"

# Kernel
BR2_LINUX_KERNEL=y
BR2_LINUX_KERNEL_CUSTOM_GIT=y
BR2_LINUX_KERNEL_CUSTOM_REPO_URL="https://gitee.com/openeuler/kernel.git"
BR2_LINUX_KERNEL_CUSTOM_REPO_VERSION="5.10.0-235.0.0"
BR2_LINUX_KERNEL_PATCH="board/raspberrypi4-64/openeuler/0000-raspberrypi-kernel.patch"
BR2_LINUX_KERNEL_DEFCONFIG="bcm2711"
BR2_LINUX_KERNEL_CONFIG_FRAGMENT_FILES="board/raspberrypi4-64/openeuler/openeuler.fragment board/raspberrypi4-64/jailhouse/jailhouse.fragment"
BR2_LINUX_KERNEL_INTREE_DTS_NAME="broadcom/bcm2711-rpi-4-b"
BR2_LINUX_KERNEL_DTS_SUPPORT=y
BR2_LINUX_KERNEL_NEEDS_HOST_OPENSSL=y

# Target packages
BR2_PACKAGE_BUSYBOX_SHOW_OTHERS=y
BR2_PACKAGE_GZIP=y
BR2_PACKAGE_GDB=y
BR2_PACKAGE_NETPERF=y
BR2_PACKAGE_RT_TESTS=y
BR2_PACKAGE_STRACE=y
BR2_PACKAGE_GREP=y
BR2_PACKAGE_CIFS_UTILS=y
BR2_PACKAGE_E2FSPROGS=y
BR2_PACKAGE_E2FSPROGS_RESIZE2FS=y
BR2_PACKAGE_MTD=y
BR2_PACKAGE_I2C_TOOLS=y
BR2_PACKAGE_PCIUTILS=y
BR2_PACKAGE_SYSSTAT=y
BR2_PACKAGE_FLICKCURL=y
BR2_PACKAGE_FLICKCURL_UTILS=y
BR2_PACKAGE_LIBCURL_CURL=y
BR2_PACKAGE_LIBCURL_VERBOSE=y
BR2_PACKAGE_COLLECTD=y
BR2_PACKAGE_COLLECTD_CURL=y
BR2_PACKAGE_COLLECTD_CURL_JSON=y
BR2_PACKAGE_COLLECTD_CURL_XML=y
BR2_PACKAGE_DHCPCD=y
BR2_PACKAGE_ETHTOOL=y
BR2_PACKAGE_IPERF=y
BR2_PACKAGE_IPERF3=y
BR2_PACKAGE_IPROUTE2=y
BR2_PACKAGE_OPENSSH=y
BR2_PACKAGE_TCPDUMP=y
BR2_PACKAGE_WGET=y
BR2_PACKAGE_WIRELESS_REGDB=y
BR2_PACKAGE_PROCPS_NG=y
BR2_PACKAGE_NANO=y
BR2_PACKAGE_VIM=y
BR2_PACKAGE_RPI_FIRMWARE=y
BR2_PACKAGE_RPI_FIRMWARE_VARIANT_PI4=y
BR2_PACKAGE_RPI_FIRMWARE_CONFIG_FILE="board/raspberrypi4-64/jailhouse/config_4_64bit.txt"
BR2_PACKAGE_RPI_FIRMWARE_CMDLINE_FILE="board/raspberrypi4-64/jailhouse/cmdline_4_64bit.txt"
BR2_PACKAGE_RPI_FIRMWARE_JAILHOUSE_DTBO_FILE="board/raspberrypi4-64/jailhouse/jailhouse-overlay.dtbo"
BR2_PACKAGE_RPI_FIRMWARE_ARM_STUB_FILE="board/raspberrypi4-64/jailhouse/bl31.bin"
BR2_PACKAGE_JAILHOUSE=y
BR2_PACKAGE_JAILHOUSE_HELPER_SCRIPTS=y
BR2_PACKAGE_ARCEOS=y
BR2_PACKAGE_ARCEOS_PLATFORM_RASPBERRYPI4B=y
BR2_PACKAGE_ARCEOS_EXAMPLE_HELLOWORLD=y
BR2_PACKAGE_PYTHON3=y
BR2_PACKAGE_PYTHON3_2TO3=y
BR2_PACKAGE_PYTHON3_BERKELEYDB=y
BR2_PACKAGE_PYTHON3_BZIP2=y
BR2_PACKAGE_PYTHON3_CODECSCJK=y
BR2_PACKAGE_PYTHON3_CURSES=y
BR2_PACKAGE_PYTHON3_DECIMAL=y
BR2_PACKAGE_PYTHON3_OSSAUDIODEV=y
BR2_PACKAGE_PYTHON3_READLINE=y
BR2_PACKAGE_PYTHON3_SSL=y
BR2_PACKAGE_PYTHON3_UNICODEDATA=y
BR2_PACKAGE_PYTHON3_SQLITE=y
BR2_PACKAGE_PYTHON3_PYEXPAT=y
BR2_PACKAGE_PYTHON3_XZ=y
BR2_PACKAGE_PYTHON3_ZLIB=y
BR2_PACKAGE_PYTHON_PIP=y
BR2_PACKAGE_PYTHON_MAKO=y

# Filesystem images
BR2_TARGET_ROOTFS_EXT2=y
BR2_TARGET_ROOTFS_EXT2_4=y
BR2_TARGET_ROOTFS_EXT2_SIZE="1G"
BR2_TARGET_ROOTFS_CPIO=y
BR2_TARGET_ROOTFS_CPIO_GZIP=y

# Bootloader
# NONE

# Host utilities
BR2_PACKAGE_HOST_DOSFSTOOLS=y
BR2_PACKAGE_HOST_GENIMAGE=y
BR2_PACKAGE_HOST_MTOOLS=y
```

## configs/raspberrypi4b_openeuler_defconfig
```kconfig
# The following contents are arranged in the order of the main menu given by make menuconfig

# Target options
BR2_aarch64=y
BR2_cortex_a72=y
BR2_ARM_FPU_VFPV4=y

# Build options
BR2_DL_DIR="$(TOPDIR)/dl"
BR2_HOST_DIR="$(BASE_DIR)/host"

# Toolchain
BR2_TOOLCHAIN_BUILDROOT_CXX=y
BR2_PACKAGE_HOST_LINUX_HEADERS_CUSTOM_5_10=y

# System configuration
BR2_SYSTEM_DHCP="eth0"
BR2_ROOTFS_POST_BUILD_SCRIPT="board/raspberrypi4-64/post-build.sh"
BR2_ROOTFS_POST_IMAGE_SCRIPT="board/raspberrypi4-64/post-image.sh"
BR2_TARGET_GENERIC_HOSTNAME="Raspberry Pi"
BR2_TARGET_GENERIC_ISSUE="Welcome to Raspberry Pi"

# Kernel
BR2_LINUX_KERNEL=y
BR2_LINUX_KERNEL_CUSTOM_GIT=y
BR2_LINUX_KERNEL_CUSTOM_REPO_URL="https://gitee.com/openeuler/raspberrypi-kernel.git"
BR2_LINUX_KERNEL_CUSTOM_REPO_VERSION="openEuler-21.09"
BR2_LINUX_KERNEL_DEFCONFIG="bcm2711"
BR2_LINUX_KERNEL_CONFIG_FRAGMENT_FILES="board/raspberrypi4-64/openeuler.fragment"
BR2_LINUX_KERNEL_INTREE_DTS_NAME="broadcom/bcm2711-rpi-4-b"
BR2_LINUX_KERNEL_DTS_SUPPORT=y
BR2_LINUX_KERNEL_NEEDS_HOST_OPENSSL=y

# Target packages
BR2_PACKAGE_RPI_FIRMWARE=y
BR2_PACKAGE_RPI_FIRMWARE_VARIANT_PI4=y
BR2_PACKAGE_RPI_FIRMWARE_CONFIG_FILE="board/raspberrypi4-64/config_4_64bit.txt"
BR2_PACKAGE_JAILHOUSE=y
BR2_PACKAGE_JAILHOUSE_HELPER_SCRIPTS=y
BR2_PACKAGE_PYTHON3=y
BR2_PACKAGE_PYTHON3_2TO3=y
BR2_PACKAGE_PYTHON3_BERKELEYDB=y
BR2_PACKAGE_PYTHON3_BZIP2=y
BR2_PACKAGE_PYTHON3_CODECSCJK=y
BR2_PACKAGE_PYTHON3_CURSES=y
BR2_PACKAGE_PYTHON3_DECIMAL=y
BR2_PACKAGE_PYTHON3_OSSAUDIODEV=y
BR2_PACKAGE_PYTHON3_READLINE=y
BR2_PACKAGE_PYTHON3_SSL=y
BR2_PACKAGE_PYTHON3_UNICODEDATA=y
BR2_PACKAGE_PYTHON3_SQLITE=y
BR2_PACKAGE_PYTHON3_PYEXPAT=y
BR2_PACKAGE_PYTHON3_XZ=y
BR2_PACKAGE_PYTHON3_ZLIB=y
BR2_PACKAGE_PYTHON_PIP=y
BR2_PACKAGE_PYTHON_MAKO=y

# Filesystem images
BR2_TARGET_ROOTFS_EXT2=y
BR2_TARGET_ROOTFS_EXT2_4=y
BR2_TARGET_ROOTFS_EXT2_SIZE="120M"

# Bootloader
# NONE

# Host utilities
BR2_PACKAGE_HOST_DOSFSTOOLS=y
BR2_PACKAGE_HOST_GENIMAGE=y
BR2_PACKAGE_HOST_MTOOLS=y
```

## package/arceos/Config.in
```kconfig
config BR2_PACKAGE_ARCEOS
	bool "ArceOS"
	help
	  ArceOS written used rust.

	  https://github.com/arceos-org/arceos

if BR2_PACKAGE_ARCEOS

choice
	prompt "ArceOS platform"

config BR2_PACKAGE_ARCEOS_PLATFORM_PHYTIUMPI
	bool "Phytium Pi"
	help
	  platforms/aarch64-phytium-pi.toml

config BR2_PACKAGE_ARCEOS_PLATFORM_RASPBERRYPI4B
	bool "Raspberry Pi 4 Model B"
	help
	  platforms/aarch64-raspi4.toml

endchoice

choice
	prompt "ArceOS example"

config BR2_PACKAGE_ARCEOS_EXAMPLE_HELLOWORLD
	bool "helloworld"
	help
	  examples/helloworld

config BR2_PACKAGE_ARCEOS_EXAMPLE_HELLOWORLD_C
	bool "helloworld-c"
	help
	  examples/helloworld-c

endchoice

endif
```

## package/phytium-free-rtos/Config.in
```kconfig
config BR2_PACKAGE_PHYTIUM_FREE_RTOS
	bool "phytium-free-rtos"
	help
	  Phytium-FreeRTOS-SDK for OpenAMP

          https://gitee.com/phytium_embedded/phytium-free-rtos-sdk

if BR2_PACKAGE_PHYTIUM_FREE_RTOS

config BR2_PACKAGE_PHYTIUM_FREE_RTOS_CPU_NAME
        string "CPU name"
        help
          Supported CPU:
	  "e2000q", "phytiumpi", "d2000", "ft2004".

endif
```

## package/phytium-standalone/Config.in
```kconfig
config BR2_PACKAGE_PHYTIUM_STANDALONE
	bool "phytium-standalone"
	help
	  Phytium-Standalone-SDK for OpenAMP

          https://gitee.com/phytium_embedded/phytium-standalone-sdk

if BR2_PACKAGE_PHYTIUM_STANDALONE

config BR2_PACKAGE_PHYTIUM_STANDALONE_CPU_NAME
        string "CPU name"
        help
          Supported CPU:
	  "e2000q", "phytiumpi", "d2000", "ft2004".

endif
```

## package/phytium-x100-um/Config.in
```kconfig
config BR2_PACKAGE_PHYTIUM_X100_UM
	bool "phytium-x100-um"
	select BR2_PACKAGE_HAS_LIBEGL
	select BR2_PACKAGE_HAS_LIBGLES
	select BR2_PACKAGE_HAS_LIBGBM
	help
	  Phytium X100 um deb package.

	  https://gitee.com/phytium_embedded/phytium-rogue-umlibs/tree/develop/

if BR2_PACKAGE_PHYTIUM_X100_UM

config BR2_PACKAGE_PROVIDES_LIBEGL
	default "phytium-x100-um"

config BR2_PACKAGE_PROVIDES_LIBGLES
	default "phytium-x100-um"

config BR2_PACKAGE_PROVIDES_LIBGBM
	default "phytium-x100-um"

endif
```

## package/phyuboot/Config.in
```kconfig
config BR2_PACKAGE_PHYUBOOT
	bool "phyuboot"
	help
	  Phytium Pi uboot firmware

if BR2_PACKAGE_PHYUBOOT
config BR2_PACKAGE_PHYUBOOT_RAMSIZE
        string "ram size"
        help
          This is a comment that defines ram size is, 2G or 4g

endif
```

## package/rpmsg-demo/Config.in
```kconfig
config BR2_PACKAGE_RPMSG_DEMO
	bool "rpmsg-demo"
	help
	  Phytium openamp rpmsg-demo.

	  https://gitee.com/phytium_embedded/phytium-embedded-docs/blob/master/open-amp/rpmsg-demo.c
```

## package/starry/Config.in
```kconfig
config BR2_PACKAGE_STARRY
	bool "STARRY"
	help
	  STARRY written used rust.

	  https://github.com/qclic/Starry

if BR2_PACKAGE_STARRY

choice
	prompt "STARRY platform"

config BR2_PACKAGE_STARRY_PLATFORM_PHYTIUMPI
	bool "Phytium Pi"
	help
	  platforms/aarch64-phytium-pi.toml

config BR2_PACKAGE_STARRY_PLATFORM_RASPBERRYPI4B
	bool "Raspberry Pi 4 Model B"
	help
	  platforms/aarch64-raspi4.toml

endchoice

choice
	prompt "STARRY example"

config BR2_PACKAGE_STARRY_EXAMPLE_HELLOWORLD
	bool "helloworld"
	help
	  apps/monolithic_userboot


endchoice

endif
```

## package/vpu-lib/Config.in
```kconfig
config BR2_PACKAGE_VPU_LIB
	bool "vpu-lib"
	help
	  This is a comment that explains what vpu-lib is. The help text
	  should be wrapped.

          https://gitee.com/phytium_embedded/vpu-lib.git

if BR2_PACKAGE_VPU_LIB

config BR2_PACKAGE_VPU_LIB_CPU_MODEL
        string "cpu model"
        help
          This is a comment that defines the cpu model, and the supported value is "d2000".

config BR2_PACKAGE_VPU_LIB_CUSTOM_TARBALL
        bool "Custom tarball"
        help
          This option allows to specify a URL pointing to a vpu-lib tarball.

config BR2_PACKAGE_VPU_LIB_CUSTOM_TARBALL_LOCATION
        string "URL of custom vpu-lib tarball"
        depends on BR2_PACKAGE_VPU_LIB_CUSTOM_TARBALL

config BR2_PACKAGE_VPU_LIB_FIRMWARE
        bool "vpu-lib firmware"
        help
          Install only vpu-lib firmware and do not install other files.

endif
```
