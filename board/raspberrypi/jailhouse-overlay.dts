// Reserves memory for use by the Jailhouse hypervisor
/dts-v1/;
/plugin/;

/ {
	compatible = "brcm,bcm2835";

	fragment@0 {
		target-path = "/";
		__overlay__ {
			
			reserved-memory {
				#address-cells = <2>;
				#size-cells = <1>;

				ranges;

				jailhouse_memory: jailhouse@40000000 {
					reg = <0x0 0x40000000 0x10000000>;
					no-map;
				};
			};
		};
	};

	__overrides__ {
		start = <&jailhouse_memory>,"reg#0";
		size  = <&jailhouse_memory>,"reg:8";
	};
};